## docker__buildroot/configs/lothars__nios2_defconfig
```kconfig
BR2_nios2=y
BR2_TOOLCHAIN_EXTERNAL=y
BR2_TARGET_GENERIC_HOSTNAME="nios2"
BR2_TARGET_GENERIC_ISSUE="Lothar's Nios II Setup"
BR2_TARGET_GENERIC_GETTY_PORT="ttyJ0"
BR2_LINUX_KERNEL=y
BR2_LINUX_KERNEL_CUSTOM_GIT=y
BR2_LINUX_KERNEL_CUSTOM_REPO_URL="https://github.com/Rubusch/linux.git"
BR2_LINUX_KERNEL_CUSTOM_REPO_VERSION="lothar/nios2-devel"
BR2_LINUX_KERNEL_DEFCONFIG="linux_hw_defconfig"
BR2_TARGET_ROOTFS_CPIO=y
BR2_TARGET_ROOTFS_CPIO_UIMAGE=y
BR2_TARGET_ROOTFS_JFFS2=y
BR2_TARGET_UBOOT=y
BR2_TARGET_UBOOT_BUILD_SYSTEM_KCONFIG=y
BR2_TARGET_UBOOT_CUSTOM_GIT=y
BR2_TARGET_UBOOT_CUSTOM_REPO_URL="https://github.com/Rubusch/u-boot.git"
BR2_TARGET_UBOOT_CUSTOM_REPO_VERSION="lothar/nios2-devel"
BR2_TARGET_UBOOT_BOARD_DEFCONFIG="linux_hw_defconfig"
BR2_TARGET_UBOOT_NEEDS_DTC=y
BR2_TARGET_UBOOT_SPL=y
```

## docker__buildroot/configs/lothars__uboot__nios2_defconfig
```kconfig
CONFIG_NIOS2=y
CONFIG_SYS_CONFIG_NAME="linux_hw"
CONFIG_NR_DRAM_BANKS=1
CONFIG_FIT=y
CONFIG_SYS_CONSOLE_INFO_QUIET=y
CONFIG_VERSION_VARIABLE=y
CONFIG_DISPLAY_BOARDINFO=y
CONFIG_DISPLAY_BOARDINFO_LATE=y
CONFIG_HUSH_PARSER=y
CONFIG_SYS_PROMPT="NIOS2> "
# CONFIG_AUTOBOOT is not set
CONFIG_CMD_CPU=y
# CONFIG_CMD_BOOTD is not set
# CONFIG_CMD_XIMG is not set
CONFIG_CMD_GPIO=y
# CONFIG_CMD_ITEST is not set
CONFIG_CMD_DHCP=y
# CONFIG_CMD_NFS is not set
CONFIG_CMD_MII=y
CONFIG_CMD_PING=y
CONFIG_DEFAULT_DEVICE_TREE="linux_hw"
CONFIG_NET_RANDOM_ETHADDR=y
CONFIG_DM_GPIO=y
CONFIG_ALTERA_PIO=y
CONFIG_LED=y
CONFIG_LED_GPIO=y
CONFIG_MISC=y
CONFIG_ALTERA_SYSID=y
CONFIG_MTD=y
CONFIG_MTD_NOR_FLASH=y
CONFIG_MTD_DEVICE=y
CONFIG_ALTERA_QSPI=y
CONFIG_PHY_MARVELL=y
CONFIG_DM_ETH=y
CONFIG_PHY_GIGE=y
CONFIG_ALTERA_TSE=y
CONFIG_DM_SERIAL=y
CONFIG_ALTERA_JTAG_UART=y
CONFIG_ALTERA_JTAG_UART_BYPASS=y
CONFIG_SYS_NS16550=y
CONFIG_TIMER=y
CONFIG_ALTERA_TIMER=y
```

## docker__buildroot/configs/nios2_defconfig
```kconfig
BR2_nios2=y
BR2_TOOLCHAIN_EXTERNAL=y
BR2_TARGET_GENERIC_HOSTNAME="nios2"
BR2_TARGET_GENERIC_ISSUE="Lothar's Nios II Setup"
BR2_TARGET_GENERIC_GETTY_PORT="ttyJ0"
BR2_TARGET_ROOTFS_CPIO=y
BR2_TARGET_ROOTFS_JFFS2=y
```
